   
#include "PinMap.h"
#include "OV7670.h"
#include "new_dib_16.h"
#include "OLEDSD13XX.h"

cDIB_virt16bpp gDib;
cOLEDSD13XX gOled;

#if 0
class cDigole : public cDeviceBase
{
public:
	cDigole() { m_init = false; m_sck_div = 10; }
	
	bool begin(uint8_t mosi, uint8_t sclk, uint8_t cs) 	{ delay(2000); return _begin("cDigole", cs, sclk, mosi, 0);	}

	void setColor256(int color) { write8('S'); write8('C');  write8(color); }
	void setColorRGB(int r, int g, int b) { write8('E'); write8('S'); write8('C'); write8(r); write8(g); write8(b); }
	void setColorBackground() { write8('B'); write8('G'); write8('C'); }

	void clearScreen() { write8('C'); write8('L'); }
	void enableCursor() { write8('C'); write8('S'); write8(1); }
	void disableCursor() { write8('C'); write8('S'); write8(0); }
	void setBacklight(int val0_100) { write8('B'); write8('L'); write8(val0_100); }
	void displayConfig(bool on) { write8('D'); write8('C'); write8(on); } // whether to show config when power on
																			 //void displayText(char *str);
	void drawRectangle(int x1, int y1, int x2, int y2) { write8('D'); write8('R'); write8(x1); write8(y1); write8(x2); write8(y2); }
	void drawFilledRectangle(int x1, int y1, int x2, int y2) { write8('D'); write8('F'); write8(x1); write8(y1); write8(x2); write8(y2); }

	void setRot0() { write8('S'); write8('D'); write8(0); }
	void setRot90() { write8('S'); write8('D'); write8(1); }
	void setRot180() { write8('S'); write8('D'); write8(2); }
	void setRot270() { write8('S'); write8('D'); write8(3); }
	void sleep() { write8('D'); write8('N'); write8('A'); write8('L');  write8('L'); }
	void wake() { write8(0); write8(0); write8(0); write8(0); delay(500); }

	void drawBitmap256(int x, int y, int w, int h) { write8('E'); write8('D'); write8('I'); write8('M'); write8('1'); write8(x); write8(y); write8(w); write8(h); }
	void drawBitmapRGB565(int x, int y, int w, int h) { write8('E'); write8('D'); write8('I'); write8('M'); write8('2'); write8(x); write8(y); write8(w); write8(h); }
	void drawBitmap262K(int x, int y, int w, int h) { write8('E'); write8('D'); write8('I'); write8('M'); write8('3'); write8(x); write8(y); write8(w); write8(h); }

	void drawPixel(int x, int y) { write8('D'); write8('P'); write8(x); write8(y); }

	void write8(uint8_t val) { checkSCKDiv(); _chip_enable(); _write8(val);  _chip_disable(); delayMicroseconds(14); } // must be 10us ... no delay = glitches

	void write16(uint16_t val) { if (val <= 255) { write8(val); } else { write8(255); write8(val - 255); } }
};

cDigole gc;

#endif


strFastPin m_led;

cOV7670 gOV7670;

const uint16_t pic[] =
{
	//----- E:\显示用图片\ER-OLED015-1.bmp
	//----- H - L, x direct, 8 pixel mode, 64k color R5G6B5.
	//----- width x height = 128 x 128, Total bytes = 32768
	0xffff,0xffff,0xffff,0xffff,0xffff,0xffff,0xffff,0xffff,0xffff,0xffff,0xffff,0xffff,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0xffff,
	0xffff,0x0000,0x0000,0x0000,0x0000,0x0000,0x0000,0x0000,0x0000,0x0000,0x0000,0x0000,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0xffff,
	0xffff,0x0000,0x0000,0x0000,0x0000,0x0000,0x0000,0x0000,0x0000,0x0000,0x0000,0x0000,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0xffff,
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	0xffff,0x0000,0x0000,0x0000,0x0000,0x0000,0x0000,0x0000,0x0000,0x0000,0x0000,0x0000,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0xffff,
};


void ColorSet(cOLEDSD13XX *g, int ptr1)
{
	g->_1351setWindow(0, 0, g->getWidth() - 1, g->getHeight() -1);
	g->_1351enableWriteRAM();
	g->_chip_enable();
	
	for (int j = 0; j<128; j++)
	{
		g->_write8(0xff);
		g->_write8(0xff);
	}
		
	for (int i = 0; i<126; i++)
	{
		g->_write8(0xff);
		g->_write8(0xff);

		for (int j = 0; j<126; j++)
		{
			g->_write8(ptr1 >> 8);
			g->_write8(ptr1);
								
		}
		g->_write8(0xff);
		g->_write8(0xff);
	}

	for (int j= 0; j<128; j++)
	{
		g->_write8(0xff);
		g->_write8(0xff);
	}

	g->_chip_disable();

	delay(15);
	
}


void intfunc()
{	
		static int cnt = 0;
		
		cnt = (cnt == 5) ? 0 : cnt + 1;

		int bar = 1 << cnt;

		fastDigitalWrite(49, bar & 1);
		fastDigitalWrite(47, bar & 2);
		fastDigitalWrite(45, bar & 4);
		fastDigitalWrite(43, bar & 8);	
}

void xxsetup()
{
	gOV7670.begin(50, 51, 31, 23, 25, 27, 29);
	uint32_t ver = gOV7670.getVersion();

	// status leds

	pinMode(49, OUTPUT);
	pinMode(47, OUTPUT);
	pinMode(45, OUTPUT);
	pinMode(43, OUTPUT);
	 
	Serial.print("Version=");
	Serial.println(ver, HEX);

	gOled.setSCKDiv(5);
	gOled.begin(OLED_init1351_128_128_15, PIN_SPI_MOSI, PIN_SPI_SCK, 22, 26, 24); // 128 * 64

	Serial.println(gOled.getWidth());
	Serial.println(gOled.getHeight());

	for (int i = 0; i < 63; i++)
	{
		ColorSet(&gOled, OLED_arr_gray0_63_565[i]); // grayscale test
	}

	gOled._1351setWindow(0, 0, gOled.getWidth() - 1, gOled.getHeight() - 1);
	gOled._1351enableWriteRAM();
	gOled._chip_enable();

	for (uint16_t b = 0; b < 128 * 128; b++)
	{
		gOled._do_wait();
		gOled._write16(pic[b] << 8 | pic[b] >> 8, false);
	}

	gOled._do_wait();
	gOled._chip_disable();

	delay(2000);

	if (gDib.begin(gOled.getWidth(), gOled.getHeight()))
	{
		Serial.println("\n\n** Allocated 16BPP buffer");
	}

	pinInit(m_led, 13, OUTPUT, HIGH);

	//gOV7670.setMode(OV_SCR_QVGA, OV_PM_YUV422);
	//gOV7670.setMode(OV_SCR_QQVGA, OV_PM_YUV422);
	
	//gOV7670.setMode(OV_SCR_VGA, OV_PM_RAW_BAYER ); // INVALID!!! 640*480 BAYER OR PROCESSED BAYER

	//gOV7670.setMode(OV_SCR_VGA, OV_PM_PROC_BAYER); // INVALID!!! 640*480 BAYER OR PROCESSED BAYER

	gOV7670.setMode(OV_SCR_QVGA, OV_PM_RGB565);
	//gOV7670.setMode(OV_SCR_QQVGA, OV_PM_RGB565);
	
	//gOV7670.setContrast(OV_CONTRAST_PLUS_2);
	//gOV7670.setBrightness(OV_BRIGHTNESS_PLUS_2);	

	//gOV7670.setNightMode(true);  // buggy as shit

	// gOV7670.setWhiteBalance(OV_WB_AUTO_SIMPLE);

	//gOV7670.setMirrorFlip(true, true);

	Serial.println(">>=================>> Camera mode w*h");
	Serial.print(gOV7670.getWidth());
	Serial.print("*");
	Serial.println(gOV7670.getHeight());

}



void setup()
{
	delay(1000);

	Serial.begin(9600);
	Serial.println("start!");

	xxsetup();
}




void loop()
{
	uint32_t t0 = micros();
	
	while (!gOV7670.isFrameReady()) { }

	intfunc();	 // leds

	// 640 * 480 bayer to 160 * 120 RGB

	int w = gOV7670.getWidth();
	int h = gOV7670.getHeight();

	int dev_w = gOled.getWidth();
	int dev_h = gOled.getHeight();								 	
		
	if (gOV7670.getPixelMode() == OV_PM_PROC_BAYER || gOV7670.getPixelMode() == OV_PM_RAW_BAYER) // raw bayer
	{	
		uint16_t *tb = gDib.getBuffer();

		//if (w == 640)
		{
			w /= 2;
		}

		int ry = 0;

		for (int y = dev_h < h ? dev_h : h; y--;)
		{
			for (int x = 0; x < w; x++)
			{
				uint8_t b[2];

				if (x < dev_w)
				{
					b[(ry + 1) & 1] = gOV7670.FIFOReadByte(); // b[0] = green
					b[(ry + 0) & 1] = gOV7670.FIFOReadByte();

					uint16_t t = OLED_arr_gray0_63_565[b[0] >> 2];

					*tb = (t << 8) | (t >> 8);
					tb++;
				}
				else
				{
					gOV7670.FIFODiscardWord();
				}
			}
			ry++;
		}

		gOV7670.WantFrame(); // start wanting now!!!!!
		gOled._1351renderScreen(gDib.getBuffer());
	}
	else if (gOV7670.getPixelMode() == OV_PM_YUV422) // QQVGA	 full out
	{			
		gOled._chip_enable();
		gOled._1351setWindow(0, 0, 127, 127);
		gOled._1351enableWriteRAM();

		uint8_t wait = 0;

		for (int y = dev_h < h ? dev_h : h; y--;)
		{
			for (int x = 0; x < w; x++)
			{
				if (x < dev_w)
				{			
					if (!wait)
					{
						wait++;
						uint16_t b2 = OLED_arr_gray0_63_565[gOV7670.FIFOReadWord() >> 10];
						b2 = (b2 << 8) | (b2 >> 8);
						gOled._write16(b2, false);
					}
					else
					{
						uint16_t b2 = OLED_arr_gray0_63_565[gOV7670.FIFOReadWord() >> 10];
						b2 = (b2 << 8) | (b2 >> 8);
						gOled._do_wait();
						gOled._write16_again(b2, false);
					}					
				}
				else
				{
					gOV7670.FIFODiscardWord();
				}
			}
			for (int x = w; x < dev_w; x++)
			{
				gOled._write16_again(0, false);
			}
		}

		gOled._do_wait();
		gOled._chip_disable();

		gOV7670.WantFrame(); // start wanting now!!!!!

	}
	else if (gOV7670.getPixelMode() == OV_PM_RGB565) // QQVGA	 full out
	{
		uint16_t buff[320*2];

		gOled._chip_enable();
		gOled._1351setWindow(0, 0, 127, 127);
		gOled._1351enableWriteRAM();
		
		uint16_t offset = 0;
		
		for (uint16_t y = dev_h < h ? dev_h : h; y--;)
		{			
			for (uint16_t x = 0; x < w; x++)
			{
				buff[offset + x] = gOV7670.FIFOReadWordRev();
				//gOled._do_wait();
				//gOled._write16_again(b2, false);
			}	
			for (uint16_t x = w; x < dev_w; x++)
			{
				buff[offset + x] = 0; // gOV7670.FIFOReadWordRev();
				//gOV7670.FIFODiscardWord();			
			}

			gOled._do_wait();
			gOled._write_small_again(&buff[offset], 2 * 128, false);
			offset ^= 320;
		}
		
		gOled._do_wait();
		gOled._chip_disable();

		gOV7670.WantFrame(); // start wanting now!!!!!
	}
	else
	{
		gOV7670.WantFrame(); // start wanting now!!!!!
	}
	
	
	

	t0 = micros() - t0;

	static uint32_t bt = 9999999;	 // 44284!!

	if (t0 < bt)
	{
		Serial.print("\n\nFrame time :");
		Serial.println(t0);
		bt = t0;
	}

	

}



